## fw/boards/arm/foc/Kconfig.foc_431
```kconfig
# SPDX-License-Identifier: Apache-2.0

config BOARD_FOC
    bool "FOC (STM32G431 Core) board support"
    default y
    select SOC_STM32G431XX
    help
      Enable configuration options specific to the FOC board.

config ENABLE_USB
    bool "Enable USB CDC-ACM support"
    default y
    select USB_DEVICE_STACK_NEXT if ENABLE_USB
    select USBD_CDC_ACM_CLASS if ENABLE_USB
    help
      Enable USB CDC-ACM device support for communication.
```

## fw/boards/arm/foc/board.yml
```yaml
board:
  name: foc_431
  full_name: STM32G431 Core Board (foc)
  vendor: foc
  socs:
    - name: stm32g431xx
```

## fw/dts/bindings/vendor-prefixes.txt
```
# This file contains a list of vendor prefixes
# used in device tree compatible strings
#
# Format: <vendor> <Full vendor name>

mps	Monolithic Power Systems Inc.
```

## west.yml
```yaml
manifest:
  self:
    west-commands: scripts/west-commands.yml

  remotes:
    - name: zephyrproject-rtos
      url-base: https://github.com/zephyrproject-rtos

  projects:
    - name: zephyr
      remote: zephyrproject-rtos
      revision: v4.3.0
      clone-depth: 1
      import:
        name-allowlist:
          - cmsis_6
          - hal_stm32
          - segger
          - hal_st
          - mcuboot
          - mbedtls
          - littlefs
        path-allowlist:
          - modules/hal/cmsis_6
          - modules/hal/stm32
          - modules/debug/segger
          - modules/hal/st
          - bootloader/mcuboot
          - modules/crypto/mbedtls
          - modules/fs/littlefs
```
